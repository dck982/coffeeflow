## firmware/ble-debug/sdkconfig.defaults
```kconfig
CONFIG_IDF_TARGET="esp32s3"
CONFIG_ESPTOOLPY_FLASHSIZE_8MB=y

CONFIG_BT_ENABLED=y
CONFIG_BT_BLUEDROID_ENABLED=n
CONFIG_BT_NIMBLE_ENABLED=y
CONFIG_BT_NIMBLE_ROLE_CENTRAL=y
CONFIG_BT_NIMBLE_ROLE_OBSERVER=y
CONFIG_BT_NIMBLE_ROLE_PERIPHERAL=n
CONFIG_BT_NIMBLE_ROLE_BROADCASTER=n
CONFIG_BT_NIMBLE_GATT_CLIENT=y
CONFIG_BT_NIMBLE_GATT_SERVER=n
CONFIG_BT_NIMBLE_SECURITY_ENABLE=n
CONFIG_BT_NIMBLE_HS_PVCY=n
CONFIG_BT_NIMBLE_MAX_CONNECTIONS=1

CONFIG_ESP_CONSOLE_USB_SERIAL_JTAG=y
CONFIG_ESP_CONSOLE_UART_DEFAULT=n
CONFIG_ESP_CONSOLE_SECONDARY_NONE=y

CONFIG_LOG_DEFAULT_LEVEL_INFO=y
CONFIG_LOG_MAXIMUM_LEVEL_INFO=y
CONFIG_BT_NIMBLE_LOG_LEVEL_NONE=y
```

## firmware/screen-lcd-test/main/Kconfig.projbuild
```kconfig
menu "LCD / radio diagnostic"

choice LCD_TEST_BOOT_SEQUENCE
    prompt "Sequence de demarrage testee"
    default LCD_TEST_LCD_WIFI_NIMBLE

config LCD_TEST_LCD_ONLY
    bool "LCD / LVGL seulement"

config LCD_TEST_LCD_WIFI
    bool "LCD / LVGL puis Wi-Fi + HTTP"

config LCD_TEST_LCD_NIMBLE
    bool "LCD / LVGL puis NimBLE"

config LCD_TEST_LCD_WIFI_NIMBLE
    bool "LCD / LVGL puis Wi-Fi + HTTP puis NimBLE"

config LCD_TEST_SWITCH_WIFI_NIMBLE
    bool "LCD / LVGL puis Wi-Fi <-> NimBLE toutes les 5 secondes"

endchoice
endmenu
```
